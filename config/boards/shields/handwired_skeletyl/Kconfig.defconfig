## config/boards/shields/handwired_skeletyl/Kconfig.defconfig
```kconfig
if SHIELD_HANDSKELETYL

config ZMK_KEYBOARD_NAME
    default "HandSkeletyl"

config ZMK_SPLIT_ROLE_CENTRAL
    default y

endif

if SHIELD_HANDSKELETYL_LEFT || SHIELD_HANDSKELETYL_RIGHT

config ZMK_SPLIT
    default y

endif
```

## config/boards/shields/handwired_skeletyl/Kconfig.shield
```kconfig
# Copyright (c) 2022 Jibran Syed
# SPDX-License-Identifier: MIT

config SHIELD_HANDSKELETYL_LEFT
    def_bool $(shields_list_contains,handskeletyl_left)

config SHIELD_HANDSKELETYL_RIGHT
    def_bool $(shields_list_contains,handskeletyl_right)
```
